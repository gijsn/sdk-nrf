## prj.conf
```kconfig
#
# Copyright (c) 2020 Nordic Semiconductor ASA
#
# SPDX-License-Identifier: LicenseRef-Nordic-5-Clause
#
# General config
CONFIG_LOG=y
CONFIG_LOG_DEFAULT_LEVEL=3
CONFIG_STACK_SENTINEL=y
CONFIG_NEWLIB_LIBC=y
CONFIG_NEWLIB_LIBC_FLOAT_PRINTF=y
CONFIG_RING_BUFFER=y

CONFIG_NRF_MODEM_LIB_TRACE_ENABLED=y

# Segger RTT
CONFIG_USE_SEGGER_RTT=y
CONFIG_RTT_CONSOLE=y
CONFIG_UART_CONSOLE=y
CONFIG_LOG_BACKEND_RTT=y
CONFIG_LOG_BACKEND_UART=y

CONFIG_NET_LOG=n
CONFIG_NET_HTTP_LOG_LEVEL_DBG=n
CONFIG_NET_SOCKETS_LOG_LEVEL_DBG=n


CONFIG_LOG_BACKEND_UART=y
CONFIG_UART_CONSOLE=y


# CONFIG_SLM_CONNECT_UART_2=y
# CONFIG_UART_2_ASYNC=y
# CONFIG_UART_2_NRF_HW_ASYNC=y
# CONFIG_UART_2_NRF_HW_ASYNC_TIMER=2
# CONFIG_UART_2_NRF_HW_ASYNC=y
# CONFIG_SLM_INTERFACE_PIN=31


# Network
CONFIG_NETWORKING=y
CONFIG_NET_SOCKETS=y
CONFIG_NET_NATIVE=n

# Modem library
CONFIG_NRF_MODEM_LIB=y
# Align the max FD entry to NRF_MODEM_MAX_SOCKET_COUNT(8)
CONFIG_POSIX_MAX_FDS=8
# Enable below for modem trace
#CONFIG_NRF_MODEM_LIB_TRACE_ENABLED=y

# Use GPIO
CONFIG_GPIO=y
CONFIG_GPIO_NRFX=y

# UART interface
CONFIG_SERIAL=y
CONFIG_UART_ASYNC_API=y
CONFIG_NRFX_TIMER2=y

# Stacks and heaps
CONFIG_MAIN_STACK_SIZE=4096
CONFIG_HEAP_MEM_POOL_SIZE=16384
CONFIG_SYSTEM_WORKQUEUE_STACK_SIZE=4096

# Device power management
CONFIG_PM_DEVICE=y

# FOTA
CONFIG_HTTP_PARSER_URL=y
CONFIG_FOTA_DOWNLOAD=y
CONFIG_FOTA_DOWNLOAD_PROGRESS_EVT=y
CONFIG_DFU_TARGET=y
CONFIG_DOWNLOAD_CLIENT=y
CONFIG_DOWNLOAD_CLIENT_STACK_SIZE=4096
CONFIG_BOOTLOADER_MCUBOOT=y
CONFIG_IMG_MANAGER=y

# FLASH
CONFIG_FLASH=y
CONFIG_FLASH_PAGE_LAYOUT=y
CONFIG_FLASH_MAP=y
CONFIG_MPU_ALLOW_FLASH_WRITE=y
CONFIG_IMG_ERASE_PROGRESSIVELY=y

# Settings
CONFIG_SETTINGS=y
CONFIG_SETTINGS_FCB=y
CONFIG_FCB=y

# nRF Cloud
CONFIG_CLOUD_API=y
CONFIG_NRF_CLOUD_MQTT=y
CONFIG_NRF_CLOUD_FOTA=n
CONFIG_NRF_CLOUD_AGPS=y
CONFIG_NRF_CLOUD_PGPS=y
CONFIG_NRF_CLOUD_CELL_POS=y
CONFIG_NRF_CLOUD_LOG_LEVEL_INF=y
CONFIG_DATE_TIME=y
CONFIG_MODEM_INFO=y
CONFIG_MODEM_INFO_ADD_DATE_TIME=n
CONFIG_AT_MONITOR=y
CONFIG_MODEM_JWT=y
# Use "nrf-<IMEI>" as the default device_id format
# Use "<device_uuid>" as the device_id format by below
#CONFIG_NRF_CLOUD_CLIENT_ID_SRC_INTERNAL_UUID=y

#
# SLM-specific configurations
#
CONFIG_SLM_CUSTOMIZED=n
CONFIG_SLM_LOG_LEVEL_INF=y
CONFIG_SLM_EXTERNAL_XTAL=n
CONFIG_SLM_START_SLEEP=n

CONFIG_SLM_UART_HWFC_RUNTIME=y

# nRF Cloud based location services
# CONFIG_SLM_AGPS=n
# CONFIG_SLM_PGPS=n
# CONFIG_SLM_CELL_POS=n
```

## overlay-native_tls.conf
```kconfig
# To build serial LTE modem native TLS socket support
# add the following to your west build command:
#       -DOVERLAY_CONFIG=overlay-native_tls.conf
#

# TLS configuration
CONFIG_SLM_NATIVE_TLS=y
CONFIG_MODEM_KEY_MGMT=y
CONFIG_NORDIC_SECURITY_BACKEND=y
CONFIG_NET_SOCKETS_OFFLOAD_TLS=n
CONFIG_NET_SOCKETS_SOCKOPT_TLS=y
CONFIG_NET_SOCKETS_TLS_MAX_CONTEXTS=2
CONFIG_NET_SOCKETS_TLS_SET_MAX_FRAGMENT_LENGTH=y
# Increase extra FD entry for TLS contexts(2)
CONFIG_POSIX_MAX_FDS=10
# Enable Socket Logging for debug
#CONFIG_NET_LOG=y
#CONFIG_NET_SOCKETS_LOG_LEVEL_DBG=y
CONFIG_MBEDTLS=y
CONFIG_MBEDTLS_TLS_LIBRARY=y
CONFIG_MBEDTLS_ENABLE_HEAP=y
# If larger TLS buffer is required for large CA chain,
# increase CONFIG_MBEDTLS_SSL_IN_CONTENT_LEN and
# CONFIG_MBEDTLS_SSL_OUT_CONTENT_LEN to 4096
# and CONFIG_MBEDTLS_HEAP_SIZE to 32768
CONFIG_MBEDTLS_SSL_IN_CONTENT_LEN=4096
CONFIG_MBEDTLS_SSL_OUT_CONTENT_LEN=4096
CONFIG_MBEDTLS_HEAP_SIZE=32768
CONFIG_MBEDTLS_SSL_SERVER_NAME_INDICATION=y
#Cipher Suite disable
CONFIG_MBEDTLS_CTR_DRBG_C=n
CONFIG_MBEDTLS_CHACHA20_C=n
CONFIG_MBEDTLS_POLY1305_C=n
CONFIG_MBEDTLS_SHA1_C=n
CONFIG_MBEDTLS_DHM_C=n
CONFIG_MBEDTLS_CMAC_C=n
CONFIG_MBEDTLS_CIPHER_MODE_CTR=n
CONFIG_MBEDTLS_CIPHER_MODE_CFB=n
CONFIG_MBEDTLS_CIPHER_MODE_OFB=n
CONFIG_MBEDTLS_KEY_EXCHANGE_DHE_PSK_ENABLED=n
CONFIG_MBEDTLS_KEY_EXCHANGE_DHE_RSA_ENABLED=n
#Cipher Suite enable
CONFIG_MBEDTLS_ECDSA_DETERMINISTIC=y
CONFIG_MBEDTLS_SHA512_C=y
CONFIG_MBEDTLS_ECDH_C=y
CONFIG_MBEDTLS_SSL_SRV_C=y
CONFIG_MBEDTLS_AES_C=y
CONFIG_MBEDTLS_CCM_C=y
CONFIG_MBEDTLS_PKCS1_V15=y
```

## boards/nrf9160dk_nrf9160_ns.overlay
```dts
/*
 * Copyright (c) 2021 Nordic Semiconductor ASA
 *
 * SPDX-License-Identifier: LicenseRef-Nordic-5-Clause
 */

 &uart0 {
	hw-flow-control;
};

&uart2 {
	compatible = "nordic,nrf-uarte";
	current-speed = <115200>;
	status = "okay";
	tx-pin = <10>;
	rx-pin = <11>;
	rts-pin = <12>;
	cts-pin = <13>;
	hw-flow-control;
};

&i2c2 {
	status = "disabled";
};
```

## src/slm_at_host.c
```c
/*
 * Copyright (c) 2019 Nordic Semiconductor ASA
 *
 * SPDX-License-Identifier: LicenseRef-Nordic-5-Clause
 */

#include <zephyr.h>
#include <stdio.h>
#include <ctype.h>
#include <logging/log.h>
#include <drivers/uart.h>
#include <hal/nrf_uarte.h>
#include <hal/nrf_gpio.h>
#include <sys/ring_buffer.h>
#include <sys/util.h>
#include <pm/device.h>
#include <string.h>
#include <init.h>
#include "slm_util.h"
#include "slm_at_host.h"
#include "slm_at_fota.h"

#include <nrfx.h>
#include <hal/nrf_power.h>

LOG_MODULE_REGISTER(slm_at_host, CONFIG_SLM_LOG_LEVEL);

#define OK_STR		"\r\nOK\r\n"
#define ERROR_STR	"\r\nERROR\r\n"
#define FATAL_STR	"FATAL ERROR\r\n"
#define SLM_SYNC_STR	"+Ready\r\n"

/** The maximum allowed length of an AT command passed through the SLM
 *  The space is allocated statically. This limit is in turn limited by
 *  Modem library's NRF_MODEM_AT_MAX_CMD_SIZE */
#define AT_MAX_CMD_LEN          4096

#define UART_RX_BUF_NUM         2
#define UART_RX_LEN             256
#define UART_RX_TIMEOUT_US      2000
#define UART_ERROR_DELAY_MS     500
#define UART_RX_MARGIN_MS       10
#define UART_TX_DATA_SIZE	1024

#define HEXDUMP_DATAMODE_MAX    16

static enum slm_operation_modes {
	SLM_AT_COMMAND_MODE,  /* AT command host or bridge */
	SLM_DATA_MODE,        /* Raw data sending */
} slm_operation_mode;

static const struct device *uart_dev;
static uint8_t at_buf[AT_MAX_CMD_LEN];
static uint16_t at_buf_len;
static bool at_buf_overflow;
static struct ring_buf data_rb;
static bool datamode_rx_disabled;
static slm_datamode_handler_t datamode_handler;
static struct k_work raw_send_work;
static struct k_work cmd_send_work;
static struct k_work datamode_quit_work;

RING_BUF_DECLARE(delayed_rb, UART_TX_DATA_SIZE);
static struct k_work delayed_send_work;

static uint8_t uart_rx_buf[UART_RX_BUF_NUM][UART_RX_LEN];
static uint8_t *next_buf;
static uint8_t *uart_tx_buf;
static bool uart_recovery_pending;
static struct k_work_delayable uart_recovery_work;

static K_SEM_DEFINE(tx_done, 0, 1);

/* global functions defined in different files */
int slm_at_parse(const char *at_cmd);
int slm_at_init(void);
void slm_at_uninit(void);
int slm_setting_uart_save(void);
int indicate_start(void);

/* global variable used across different files */
struct at_param_list at_param_list;           /* For AT parser */
char rsp_buf[SLM_AT_CMD_RESPONSE_MAX_LEN];    /* SLM URC and socket data */
uint16_t datamode_time_limit;                 /* Send trigger by time in data mode */

/* global variable defined in different files */
extern bool uart_configured;
extern struct uart_config slm_uart;

static int uart_send(const uint8_t *buffer, size_t len)
{
	int ret;
	enum pm_device_state state = PM_DEVICE_STATE_OFF;

	pm_device_state_get(uart_dev, &state);
	if (state != PM_DEVICE_STATE_ACTIVE) {
		(void)indicate_start();
		return -EAGAIN;
	}

	k_sem_take(&tx_done, K_FOREVER);

	uart_tx_buf = k_malloc(len);
	if (uart_tx_buf == NULL) {
		LOG_WRN("No ram buffer");
		k_sem_give(&tx_done);
		return -ENOMEM;
	}

	memcpy(uart_tx_buf, buffer, len);
	ret = uart_tx(uart_dev, uart_tx_buf, len, SYS_FOREVER_US);
	if (ret) {
		LOG_WRN("uart_tx failed: %d", ret);
		k_free(uart_tx_buf);
		k_sem_give(&tx_done);
	}

	return ret;
}

void rsp_send(const char *str, size_t len)
{
	if (len == 0) {
		return;
	}

	LOG_HEXDUMP_DBG(str, len, "TX");
	if (uart_send(str, len) < 0) {
		ring_buf_put(&delayed_rb, str, len);
	}
}

void data_send(const uint8_t *data, size_t len)
{
	LOG_HEXDUMP_DBG(data, MIN(len, HEXDUMP_DATAMODE_MAX), "TX-DATA");
	if (uart_send(data, len) < 0) {
		ring_buf_put(&delayed_rb, data, len);
	}
}

static int uart_receive(void)
{
	int ret;

	ret = uart_rx_enable(uart_dev, uart_rx_buf[0], sizeof(uart_rx_buf[0]), UART_RX_TIMEOUT_US);
	if (ret && ret != -EBUSY) {
		LOG_ERR("UART RX failed: %d", ret);
		rsp_send(FATAL_STR, sizeof(FATAL_STR) - 1);
		return ret;
	}
	next_buf = uart_rx_buf[1];
	at_buf_overflow = false;
	at_buf_len = 0;

	return 0;
}

static void uart_recovery(struct k_work *work)
{
	ARG_UNUSED(work);

	(void)uart_receive();
	uart_recovery_pending = false;
	LOG_DBG("UART recovered");
}

int enter_datamode(slm_datamode_handler_t handler)
{
	if (handler == NULL || datamode_handler != NULL) {
		LOG_INF("Invalid, not enter datamode");
		return -EINVAL;
	}

	ring_buf_init(&data_rb, sizeof(at_buf), at_buf);
	datamode_handler = handler;
	slm_operation_mode = SLM_DATA_MODE;
	if (datamode_time_limit == 0) {
		if (slm_uart.baudrate > 0) {
			datamode_time_limit = UART_RX_LEN * (8 + 1 + 1) * 1000 / slm_uart.baudrate;
			datamode_time_limit += UART_RX_MARGIN_MS;
		} else {
			LOG_WRN("Baudrate not set");
			datamode_time_limit = 1000;
		}
	}
	LOG_INF("Enter datamode");

	return 0;
}

bool in_datamode(void)
{
	return (slm_operation_mode == SLM_DATA_MODE);
}

bool exit_datamode(int exit_mode)
{
	if (slm_operation_mode == SLM_DATA_MODE) {
		ring_buf_reset(&data_rb);
		/* reset UART to restore command mode */
		uart_rx_disable(uart_dev);
		k_sleep(K_MSEC(10));
		(void)uart_receive();

		if (exit_mode == DATAMODE_EXIT_OK) {
			strcpy(rsp_buf, OK_STR);
		} else if (exit_mode == DATAMODE_EXIT_ERROR) {
			strcpy(rsp_buf, ERROR_STR);
		} else {
			sprintf(rsp_buf, "\r\n#XDATAMODE: 0\r\n");
		}
		rsp_send(rsp_buf, strlen(rsp_buf));

		slm_operation_mode = SLM_AT_COMMAND_MODE;
		datamode_handler = NULL;
		LOG_INF("Exit datamode");
		return true;
	}

	return false;
}

int poweroff_uart(void)
{
	int err;

	uart_rx_disable(uart_dev);
	k_sleep(K_MSEC(100));
	err = pm_device_action_run(uart_dev, PM_DEVICE_ACTION_SUSPEND);
	if (err && err != -EALREADY) {
		LOG_ERR("Can't suspend uart: %d", err);
	}

	return err;
}

static void delayed_send(struct k_work *work)
{
	uint8_t *data = NULL;
	int size_send;

	/* NOTE ring_buf_get_claim() might not return full size */
	do {
		size_send = ring_buf_get_claim(&delayed_rb, &data, UART_TX_DATA_SIZE);
		if (data != NULL && size_send > 0) {
			(void)uart_send(data, size_send);
			(void)ring_buf_get_finish(&delayed_rb, size_send);
		} else {
			break;
		}
	} while (true);
}

int poweron_uart(void)
{
	int err;

	err = pm_device_action_run(uart_dev, PM_DEVICE_ACTION_RESUME);
	if (err && err != -EALREADY) {
		LOG_ERR("Can't resume uart: %d", err);
		return err;
	}

	k_sleep(K_MSEC(100));

	err = uart_receive();
	if (err) {
		return err;
	}
	
	k_sem_give(&tx_done);
	LOG_WRN("printing from poweron uart");
	LOG_HEXDUMP_WRN(SLM_SYNC_STR, strlen(SLM_SYNC_STR), "TX");
	rsp_send(SLM_SYNC_STR, strlen(SLM_SYNC_STR));

	return 0;
}

int slm_uart_configure(void)
{
	int err;

	LOG_DBG("Set uart baudrate to: %d, hw flow control %d", slm_uart.baudrate,
		slm_uart.flow_ctrl);

	err = uart_configure(uart_dev, &slm_uart);
	if (err != 0) {
		LOG_ERR("uart_configure: %d", err);
		return err;
	}
#if defined(CONFIG_SLM_UART_HWFC_RUNTIME)
/* Set HWFC dynamically */
	#if defined(CONFIG_SLM_CONNECT_UART_0)
	LOG_WRN("Setting RTS CTS configuration");
		#define RTS_PIN DT_PROP(DT_NODELABEL(uart0), rts_pin)
		#define CTS_PIN DT_PROP(DT_NODELABEL(uart0), cts_pin)
		if (slm_uart.flow_ctrl == UART_CFG_FLOW_CTRL_RTS_CTS) {
			LOG_WRN("Setting UART0 RTS CTS");
			nrf_uarte_hwfc_pins_set(NRF_UARTE0,
						RTS_PIN,
						CTS_PIN);
		} else {
			LOG_WRN("Clearing RTS state");
			nrf_gpio_pin_clear(RTS_PIN);
			nrf_gpio_cfg_output(RTS_PIN);
		}
	#endif
	#if defined(CONFIG_SLM_CONNECT_UART_2)
		#define RTS_PIN DT_PROP(DT_NODELABEL(uart2), rts_pin)
		#define CTS_PIN DT_PROP(DT_NODELABEL(uart2), cts_pin)
		if (slm_uart.flow_ctrl == UART_CFG_FLOW_CTRL_RTS_CTS) {
			nrf_uarte_hwfc_pins_set(NRF_UARTE2,
						RTS_PIN,
						CTS_PIN);
		} else {
			nrf_gpio_pin_clear(RTS_PIN);
			nrf_gpio_cfg_output(RTS_PIN);
		}
	#endif
#endif
	return err;
}

bool verify_datamode_control(uint16_t time_limit, uint16_t *min_time_limit)
{
	int min_time;

	if (slm_uart.baudrate == 0) {
		LOG_ERR("Baudrate not set");
		return false;
	}

	min_time = UART_RX_LEN * (8 + 1 + 1) * 1000 / slm_uart.baudrate;
	min_time += UART_RX_MARGIN_MS;

	if (time_limit == 0 || min_time > time_limit) {
		LOG_ERR("Invalid time_limit: %d, min: %d", time_limit, min_time);
		return false;
	}

	if (min_time_limit) {
		*min_time_limit = min_time;
	}

	return true;
}

AT_MONITOR(at_notify, ANY, notification_handler);

static void notification_handler(const char *response)
{
	if (slm_operation_mode == SLM_AT_COMMAND_MODE) {
		/* Forward the data over UART */
		rsp_send("\r\n", 2);
		rsp_send(response, strlen(response));
	}
}

static void raw_send(struct k_work *work)
{
	uint8_t *data = NULL;
	int size_send, size_sent;
	const char *quit_str = CONFIG_SLM_DATAMODE_TERMINATOR;
	int quit_str_len = strlen(quit_str);
	bool datamode_off_pending = false;

	ARG_UNUSED(work);

	/* NOTE ring_buf_get_claim() might not return full size */
	do {
		size_send = ring_buf_get_claim(&data_rb, &data, sizeof(at_buf));
		if (data != NULL && size_send > 0) {
			/* Exit datamode if apply */
			if (size_send >= quit_str_len) {
				char *quit = data + (size_send - quit_str_len);

				if (strncmp(quit, quit_str, quit_str_len) == 0) {
					memset(quit, 0x00, quit_str_len);
					size_send -= quit_str_len;
					datamode_off_pending = true;
				}
				if (size_send == 0) {
					k_work_submit(&datamode_quit_work);
					LOG_INF("datamode off pending");
					return;
				}
			}
			/* Raw data sending */
			int size_finish = datamode_off_pending ? quit_str_len : 0;

			LOG_INF("Raw send %d", size_send);
			//LOG_HEXDUMP_DBG(data, MIN(size_send, HEXDUMP_DATAMODE_MAX), "RX-DATAMODE");
			if (datamode_handler && size_send > 0) {
				size_sent = datamode_handler(DATAMODE_SEND, data, size_send);
				if (size_sent > 0) {
					size_finish += size_sent;
				} else if (size_sent == 0) {
					size_finish += size_send;
				} else {
					LOG_WRN("Raw send failed, %d dropped", size_send);
					size_finish += size_send;
					datamode_off_pending = true;
				}
				(void)ring_buf_get_finish(&data_rb, size_finish);
			} else {
				LOG_WRN("no handler, %d dropped", size_send);
				(void)ring_buf_get_finish(&data_rb, size_send + size_finish);
			}

			if (datamode_off_pending) {
				k_work_submit(&datamode_quit_work);
				LOG_INF("datamode off pending");
				return;
			}
		} else {
			break;
		}
	} while (true);

	/* resume UART RX in case of stopped by buffer full */
	if (datamode_rx_disabled) {
		(void)uart_receive();
		nrf_gpio_pin_clear(RTS_PIN);
		datamode_rx_disabled = false;
	}
}

static void inactivity_timer_handler(struct k_timer *timer)
{
	ARG_UNUSED(timer);

	LOG_INF("time limit reached");
	sprintf(rsp_buf, "\r\nOK\r\n");
	rsp_send(rsp_buf, strlen(rsp_buf));
	if (!ring_buf_is_empty(&data_rb)) {
		k_work_submit(&raw_send_work);
	} else {
		LOG_WRN("data buffer empty");
	}
}

K_TIMER_DEFINE(inactivity_timer, inactivity_timer_handler, NULL);

static void datamode_quit(struct k_work *work)
{
	ARG_UNUSED(work);

	/* quit datamode */
	if (datamode_handler) {
		(void)datamode_handler(DATAMODE_EXIT, NULL, 0);
	} else {
		LOG_WRN("missing datamode handler");
	}
	(void)exit_datamode(DATAMODE_EXIT_OK);
}

static int raw_rx_handler(const uint8_t *data, int datalen)
{
	int ret;

	k_timer_stop(&inactivity_timer);

	/* save data to buffer */
	ret = ring_buf_put(&data_rb, data, datalen);
	if (ret != datalen) {
		LOG_ERR("enqueue data error (%d, %d)", datalen, ret);
		uart_rx_disable(uart_dev);
		return -1;
	}
	ret = ring_buf_space_get(&data_rb);
	if (ret < UART_RX_LEN) {
		LOG_WRN("data buffer full (%d)", ret);
		//uart_rx_disable(uart_dev);
		nrf_gpio_pin_set(RTS_PIN);
		return -1;
	}

	/* start/restart inactivity timer */
	k_timer_start(&inactivity_timer, K_MSEC(datamode_time_limit), K_NO_WAIT);

	return 0;
}

/*
 * Check AT command grammar based on below.
 *  AT<NULL>
 *  AT<separator><body><NULL>
 *  AT<separator><body>=<NULL>
 *  AT<separator><body>?<NULL>
 *  AT<separator><body>=?<NULL>
 *  AT<separator><body>=<parameters><NULL>
 * In which
 * <separator>: +, %, #
 * <body>: alphanumeric char only, size > 0
 * <parameters>: arbitrary, size > 0
 */
static int cmd_grammar_check(const uint8_t *cmd, uint16_t length)
{
	const uint8_t *body;

	/* check AT (if not, no check) */
	if (length < 2 || toupper((int)cmd[0]) != 'A' || toupper((int)cmd[1]) != 'T') {
		return -EINVAL;
	}

	/* check AT<NULL> */
	cmd += 2;
	if (*cmd == '\0') {
		return 0;
	}

	/* check AT<separator> */
	if ((*cmd != '+') && (*cmd != '%') && (*cmd != '#')) {
		return -EINVAL;
	}

	/* check AT<separator><body> */
	cmd += 1;
	body = cmd;
	while (true) {
		/* check body is alphanumeric */
		if (!isalpha((int)*cmd) && !isdigit((int)*cmd)) {
			break;
		}
		cmd++;
	}

	/* check body size > 0 */
	if (cmd == body) {
		return -EINVAL;
	}

	/* check AT<separator><body><NULL> */
	if (*cmd == '\0') {
		return 0;
	}

	/* check AT<separator><body>= or check AT<separator><body>? */
	if (*cmd != '=' && *cmd != '?') {
		return -EINVAL;
	}

	/* check AT<separator><body>?<NULL> */
	if (*cmd == '?') {
		cmd += 1;
		if (*cmd == '\0') {
			return 0;
		} else {
			return -EINVAL;
		}
	}

	/* check AT<separator><body>=<NULL> */
	cmd += 1;
	if (*cmd == '\0') {
		return 0;
	}

	/* check AT<separator><body>=?<NULL> */
	if (*cmd == '?') {
		cmd += 1;
		if (*cmd == '\0') {
			return 0;
		} else {
			return -EINVAL;
		}
	}

	/* no need to check AT<separator><body>=<parameters><NULL> */
	return 0;
}

static void cmd_send(struct k_work *work)
{
	int err;

	ARG_UNUSED(work);

	if (at_buf_overflow) {
		rsp_send(ERROR_STR, sizeof(ERROR_STR) - 1);
		goto done;
	}

	//LOG_HEXDUMP_DBG(at_buf, at_buf_len, "RX");

	if (cmd_grammar_check(at_buf, at_buf_len) != 0) {
		LOG_ERR("AT command invalid");
		rsp_send(ERROR_STR, sizeof(ERROR_STR) - 1);
		goto done;
	}

	err = slm_at_parse(at_buf);
	if (err == 0) {
		if (!in_datamode()) {
			rsp_send(OK_STR, sizeof(OK_STR) - 1);
		}
		goto done;
	} else if (err != -ENOENT) {
		rsp_send(ERROR_STR, sizeof(ERROR_STR) - 1);
		goto done;
	}

	/* Send to modem */
	err = nrf_modem_at_cmd(at_buf, sizeof(at_buf), "%s", at_buf);
	if (err < 0) {
		LOG_ERR("AT command failed: %d", err);
		rsp_send(ERROR_STR, sizeof(ERROR_STR) - 1);
		goto done;
	} else if (err > 0) {
		LOG_ERR("AT command error, type: %d", nrf_modem_at_err_type(err));
	}

	if (strlen(at_buf) > 0) {
		rsp_send("\r\n", 2);
		rsp_send(at_buf, strlen(at_buf));
	}

done:
	(void)uart_receive();
}

static int cmd_rx_handler(uint8_t character)
{
	static bool inside_quotes;
	static size_t at_cmd_len;

	/* Handle control characters */
	switch (character) {
	case 0x08: /* Backspace. */
		/* Fall through. */
	case 0x7F: /* DEL character */
		if (at_cmd_len > 0) {
			at_cmd_len--;
		}
		return 0;
	}

	/* Handle termination characters, if outside quotes. */
	if (!inside_quotes) {
		switch (character) {
		case '\r':
#if defined(CONFIG_SLM_CR_TERMINATION)
			goto send;
#else
			break;
#endif
		case '\n':
#if defined(CONFIG_SLM_LF_TERMINATION)
			goto send;
#elif defined(CONFIG_SLM_CR_LF_TERMINATION)
			if (at_cmd_len > 0 && at_buf[at_cmd_len - 1] == '\r') {
				at_cmd_len--; /* trim the CR char */
				goto send;
			}
#endif
			break;
		}
	}

	/* Write character to AT buffer */
	at_buf[at_cmd_len] = character;
	at_cmd_len++;

	/* Detect AT command buffer overflow, leaving space for null */
	if (at_cmd_len > sizeof(at_buf) - 1) {
		LOG_ERR("Buffer overflow");
		at_cmd_len--;
		at_buf_overflow = true;
		goto send;
	}

	/* Handle special written character */
	if (character == '"') {
		inside_quotes = !inside_quotes;
	}

	return 0;

send:
	uart_rx_disable(uart_dev);

	at_buf[at_cmd_len] = '\0';
	at_buf_len = at_cmd_len;
	k_work_submit(&cmd_send_work);

	inside_quotes = false;
	at_cmd_len = 0;
	if (at_buf_overflow) {
		return -1;
	}
	return 0;
}

static void uart_callback(const struct device *dev, struct uart_event *evt, void *user_data)
{
	int err;
	static uint16_t pos;
	static bool enable_rx_retry;

	ARG_UNUSED(dev);
	ARG_UNUSED(user_data);

	switch (evt->type) {
	case UART_TX_DONE:
		k_free(uart_tx_buf);
		k_sem_give(&tx_done);
		break;
	case UART_TX_ABORTED:
		k_free(uart_tx_buf);
		k_sem_give(&tx_done);
		LOG_INF("TX_ABORTED");
		break;
	case UART_RX_RDY:
		if (slm_operation_mode == SLM_AT_COMMAND_MODE) {
			for (int i = pos; i < (pos + evt->data.rx.len); i++) {
				err = cmd_rx_handler(evt->data.rx.buf[i]);
				if (err) {
					return;
				}
			}
		} else if (slm_operation_mode == SLM_DATA_MODE) {
			LOG_DBG("RX_RDY %d", evt->data.rx.len);
			err = raw_rx_handler(&(evt->data.rx.buf[pos]), evt->data.rx.len);
			if (err) {
				return;
			}
		} else {
			LOG_WRN("No handler");
		}
		pos += evt->data.rx.len;
		break;
	case UART_RX_BUF_REQUEST:
		pos = 0;
		err = uart_rx_buf_rsp(uart_dev, next_buf, sizeof(uart_rx_buf[0]));
		if (err) {
			LOG_WRN("UART RX buf rsp: %d", err);
		}
		break;
	case UART_RX_BUF_RELEASED:
		next_buf = evt->data.rx_buf.buf;
		break;
	case UART_RX_STOPPED:
		LOG_WRN("RX_STOPPED (%d)", evt->data.rx_stop.reason);
		/* Retry automatically in case of UART ERROR interrupt */
		if (evt->data.rx_stop.reason != 0) {
			enable_rx_retry = true;
		}
		break;
	case UART_RX_DISABLED:
		LOG_WRN("RX_DISABLED");
		if (slm_operation_mode == SLM_DATA_MODE) {
			datamode_rx_disabled = true;
			/* flush data in ring-buffer, if any */
			k_work_submit(&raw_send_work);
		}
		if (enable_rx_retry && !uart_recovery_pending) {
			k_work_schedule(&uart_recovery_work, K_MSEC(UART_ERROR_DELAY_MS));
			enable_rx_retry = false;
			uart_recovery_pending = true;
		}
		break;
	default:
		break;
	}
}

int slm_at_host_init(void)
{
	int err;
	uint32_t start_time;

	/* Initialize the UART module */
#if defined(CONFIG_SLM_CONNECT_UART_0)
	uart_dev = device_get_binding(DT_LABEL(DT_NODELABEL(uart0)));
#elif defined(CONFIG_SLM_CONNECT_UART_2)
	uart_dev = device_get_binding(DT_LABEL(DT_NODELABEL(uart2)));
#else
	LOG_ERR("Unsupported UART instance");
	return -EINVAL;
#endif
	if (uart_dev == NULL) {
		LOG_ERR("Cannot bind UART device\n");
		return -EINVAL;
	}
	/* Save UART configuration to setting page */
	if (!uart_configured) {
		uart_configured = true;
		err = uart_config_get(uart_dev, &slm_uart);
		if (err != 0) {
			LOG_ERR("uart_config_get: %d", err);
			return err;
		}
		err = slm_setting_uart_save();
		if (err != 0) {
			LOG_ERR("slm_setting_uart_save: %d", err);
			return err;
		}
	} else {
		/* else re-config UART based on setting page */
		LOG_DBG("UART baud: %d d/p/s-bits: %d/%d/%d HWFC: %d",
			slm_uart.baudrate, slm_uart.data_bits, slm_uart.parity,
			slm_uart.stop_bits, slm_uart.flow_ctrl);
		err = slm_uart_configure();
		if (err != 0) {
			LOG_ERR("Fail to set uart baudrate: %d", err);
			return err;
		}
	}
	/* Wait for the UART line to become valid */
	start_time = k_uptime_get_32();
	do {
		err = uart_err_check(uart_dev);
		if (err) {
			uint32_t now = k_uptime_get_32();

			if (now - start_time > UART_ERROR_DELAY_MS) {
				LOG_ERR("UART check failed: %d", err);
				return -EIO;
			}
			k_sleep(K_MSEC(10));
		}
	} while (err);
	/* Register async handling callback */
	err = uart_callback_set(uart_dev, uart_callback, NULL);
	if (err) {
		LOG_ERR("Cannot set callback: %d", err);
		return -EFAULT;
	}
	err = uart_receive();
	if (err) {
		return -EFAULT;
	}

	/* Initialize AT Parser */
	err = at_params_list_init(&at_param_list, CONFIG_SLM_AT_MAX_PARAM);
	if (err) {
		LOG_ERR("Failed to init AT Parser: %d", err);
		return err;
	}

	datamode_time_limit = 0;
	datamode_handler = NULL;

	err = slm_at_init();
	if (err) {
		return -EFAULT;
	}

	k_work_init(&raw_send_work, raw_send);
	k_work_init(&cmd_send_work, cmd_send);
	k_work_init(&datamode_quit_work, datamode_quit);
	k_work_init(&delayed_send_work, delayed_send);
	k_work_init_delayable(&uart_recovery_work, uart_recovery);
	k_sem_give(&tx_done);
	k_sleep(K_MSEC(200));
	LOG_WRN("printing from init slm %d", nrf_power_resetreas_get(NRF_POWER_NS));
	nrf_power_resetreas_get(NRF_POWER_NS);
	LOG_HEXDUMP_WRN(SLM_SYNC_STR, strlen(SLM_SYNC_STR), "TX");
	rsp_send(SLM_SYNC_STR, strlen(SLM_SYNC_STR));
	slm_fota_post_process();

	slm_operation_mode = SLM_AT_COMMAND_MODE;
	LOG_INF("at_host init done");
	return 0;
}

void slm_at_host_uninit(void)
{
	int err;

	if (slm_operation_mode == SLM_DATA_MODE) {
		k_timer_stop(&inactivity_timer);
	}
	datamode_handler = NULL;

	slm_at_uninit();

	/* Power off UART module */
	uart_rx_disable(uart_dev);
	k_sleep(K_MSEC(100));
	err = pm_device_action_run(uart_dev, PM_DEVICE_ACTION_SUSPEND);
	if (err) {
		LOG_WRN("Can't suspend uart: %d", err);
	}

	/* Un-initialize AT Parser */
	at_params_list_free(&at_param_list);

	LOG_DBG("at_host uninit done");
}
```

## src/slm_at_tcp_proxy.c
```c
/*
 * Copyright (c) 2020 Nordic Semiconductor ASA
 *
 * SPDX-License-Identifier: LicenseRef-Nordic-5-Clause
 */
#include <logging/log.h>
#include <zephyr.h>
#include <stdio.h>
#include <string.h>
#include <net/socket.h>
#include "slm_util.h"
#include "slm_native_tls.h"
#include "slm_at_host.h"
#include "slm_at_tcp_proxy.h"

LOG_MODULE_REGISTER(slm_tcp, CONFIG_SLM_LOG_LEVEL);

#define THREAD_STACK_SIZE	KB(4)
#define THREAD_PRIORITY		K_LOWEST_APPLICATION_THREAD_PRIO

/* Some features need future modem firmware support */
#define SLM_TCP_PROXY_FUTURE_FEATURE	0

/**@brief Proxy operations. */
enum slm_tcp_proxy_operation {
	SERVER_STOP,
	CLIENT_DISCONNECT = SERVER_STOP,
	SERVER_START,
	CLIENT_CONNECT = SERVER_START,
	SERVER_START6,
	CLIENT_CONNECT6 = SERVER_START6
};

/**@brief Proxy roles. */
enum slm_tcp_role {
	TCP_ROLE_CLIENT,
	TCP_ROLE_SERVER
};

static struct k_thread tcp_thread;
static K_THREAD_STACK_DEFINE(tcp_thread_stack, THREAD_STACK_SIZE);
static bool server_stop_pending;

static struct tcp_proxy {
	int sock;		/* Socket descriptor. */
	int family;		/* Socket address family */
	sec_tag_t sec_tag;	/* Security tag of the credential */
	int sock_peer;		/* Socket descriptor for peer. */
	enum slm_tcp_role role;	/* Client or Server proxy */
} proxy;

/* global variable defined in different files */
extern struct at_param_list at_param_list;
extern char rsp_buf[SLM_AT_CMD_RESPONSE_MAX_LEN];

/** forward declaration of thread function **/
static void tcpcli_thread_func(void *p1, void *p2, void *p3);
static void tcpsvr_thread_func(void *p1, void *p2, void *p3);

static int do_tcp_server_start(uint16_t port)
{
	int ret;
	int reuseaddr = 1;

#if defined(CONFIG_SLM_NATIVE_TLS)
	if (proxy.sec_tag != INVALID_SEC_TAG) {
		ret = slm_tls_loadcrdl(proxy.sec_tag);
		if (ret < 0) {
			LOG_ERR("Fail to load credential: %d", ret);
			return -EAGAIN;
		}
	}
#else
#if !SLM_TCP_PROXY_FUTURE_FEATURE
/* TLS server not officially supported by modem yet */
	if (proxy.sec_tag != INVALID_SEC_TAG) {
		LOG_ERR("Not supported");
		return -ENOTSUP;
	}
#endif
#endif
	/* Open socket */
	if (proxy.sec_tag == INVALID_SEC_TAG) {
		ret = socket(proxy.family, SOCK_STREAM, IPPROTO_TCP);
	} else {
#if defined(CONFIG_SLM_NATIVE_TLS)
		ret = socket(proxy.family, SOCK_STREAM | SOCK_NATIVE_TLS, IPPROTO_TLS_1_2);
#else
		ret = socket(proxy.family, SOCK_STREAM, IPPROTO_TLS_1_2);
#endif
	}
	if (ret < 0) {
		LOG_ERR("socket() failed: %d", -errno);
		ret = -errno;
		goto exit_svr;
	}
	proxy.sock = ret;

	/* Config socket options */
	if (proxy.sec_tag != INVALID_SEC_TAG) {
		sec_tag_t sec_tag_list[1] = { proxy.sec_tag };

		ret = setsockopt(proxy.sock, SOL_TLS, TLS_SEC_TAG_LIST, sec_tag_list,
				 sizeof(sec_tag_t));
		if (ret) {
			LOG_ERR("setsockopt(TLS_SEC_TAG_LIST) error: %d", -errno);
			ret = -errno;
			goto exit_svr;
		}
#if SLM_TCP_PROXY_FUTURE_FEATURE
/* TLS server not officially supported by modem yet */
		int tls_role = TLS_DTLS_ROLE_SERVER;
		int peer_verify = TLS_PEER_VERIFY_NONE;

		ret = setsockopt(proxy.sock, SOL_TLS, TLS_DTLS_ROLE, &tls_role, sizeof(int));
		if (ret) {
			LOG_ERR("setsockopt(TLS_DTLS_ROLE) error: %d", -errno);
			ret = -errno;
			goto exit_svr;
		}
		ret = setsockopt(proxy.sock, SOL_TLS, TLS_PEER_VERIFY, &peer_verify,
				 sizeof(peer_verify));
		if (ret) {
			LOG_ERR("setsockopt(TLS_PEER_VERIFY) error: %d", errno);
			ret = -errno;
			goto exit_svr;
		}
#endif
	}

	ret = setsockopt(proxy.sock, SOL_SOCKET, SO_REUSEADDR, &reuseaddr, sizeof(int));
	if (ret < 0) {
		LOG_ERR("setsockopt(SO_REUSEADDR): %d", -errno);
		ret = -errno;
		goto exit_svr;
	}

	/* Bind to local port */
	if (proxy.family == AF_INET) {
		char ipv4_addr[NET_IPV4_ADDR_LEN] = {0};

		util_get_ip_addr(0, ipv4_addr, NULL);
		if (strlen(ipv4_addr) == 0) {
			LOG_ERR("Unable to obtain local IPv4 address");
			ret = -ENETUNREACH;
			goto exit_svr;
		}

		struct sockaddr_in local = {
			.sin_family = AF_INET,
			.sin_port = htons(port)
		};

		if (inet_pton(AF_INET, ipv4_addr, &local.sin_addr) != 1) {
			LOG_ERR("Parse local IPv4 address failed: %d", -errno);
			ret = -EINVAL;
			goto exit_svr;
		}
		ret = bind(proxy.sock, (struct sockaddr *)&local, sizeof(struct sockaddr_in));
	} else {
		char ipv6_addr[NET_IPV6_ADDR_LEN] = {0};

		util_get_ip_addr(0, NULL, ipv6_addr);
		if (strlen(ipv6_addr) == 0) {
			LOG_ERR("Unable to obtain local IPv6 address");
			ret = -ENETUNREACH;
			goto exit_svr;
		}

		struct sockaddr_in6 local = {
			.sin6_family = AF_INET6,
			.sin6_port = htons(port)
		};

		if (inet_pton(AF_INET6, ipv6_addr, &local.sin6_addr) != 1) {
			LOG_ERR("Parse local IPv6 address failed: %d", -errno);
			ret = -EINVAL;
			goto exit_svr;
		}
		ret = bind(proxy.sock, (struct sockaddr *)&local, sizeof(struct sockaddr_in6));
	}
	if (ret) {
		LOG_ERR("bind() failed: %d", -errno);
		ret = -errno;
		goto exit_svr;
	}

	/* Enable listen */
	ret = listen(proxy.sock, 1);
	if (ret < 0) {
		LOG_ERR("listen() failed: %d", -errno);
		ret = -EINVAL;
		goto exit_svr;
	}

	k_thread_create(&tcp_thread, tcp_thread_stack,
			K_THREAD_STACK_SIZEOF(tcp_thread_stack),
			tcpsvr_thread_func, NULL, NULL, NULL,
			THREAD_PRIORITY, K_USER, K_NO_WAIT);
	proxy.role = TCP_ROLE_SERVER;
	sprintf(rsp_buf, "\r\n#XTCPSVR: %d,\"started\"\r\n", proxy.sock);
	rsp_send(rsp_buf, strlen(rsp_buf));

	return 0;

exit_svr:
#if defined(CONFIG_SLM_NATIVE_TLS)
	if (proxy.sec_tag != INVALID_SEC_TAG) {
		(void)slm_tls_unloadcrdl(proxy.sec_tag);
		proxy.sec_tag = INVALID_SEC_TAG;
	}
#endif
	if (proxy.sock != INVALID_SOCKET) {
		close(proxy.sock);
		proxy.sock = INVALID_SOCKET;
	}
	sprintf(rsp_buf, "\r\n#XTCPSVR: %d,\"not started\"\r\n", ret);
	rsp_send(rsp_buf, strlen(rsp_buf));

	return ret;
}

static int do_tcp_server_stop(void)
{
	int ret;

	if (proxy.sock == INVALID_SOCKET) {
		return 0;
	}
#if defined(CONFIG_SLM_NATIVE_TLS)
	if (proxy.sec_tag != INVALID_SEC_TAG) {
		(void)slm_tls_unloadcrdl(proxy.sec_tag);
		proxy.sec_tag = INVALID_SEC_TAG;
	}
#endif
	server_stop_pending = true;
	if (proxy.sock_peer != INVALID_SOCKET) {
		(void)close(proxy.sock_peer);
		proxy.sock_peer = INVALID_SOCKET;
		sprintf(rsp_buf, "\r\n#XTCPSVR: 0,\"disconnected\"\r\n");
		rsp_send(rsp_buf, strlen(rsp_buf));
	} else {
		ret = close(proxy.sock);
		if (ret < 0) {
			LOG_WRN("close() failed: %d", -errno);
			return ret;
		}
		proxy.sock = INVALID_SOCKET;
	}
	if (k_thread_join(&tcp_thread, K_SECONDS(CONFIG_SLM_TCP_POLL_TIME + 1)) != 0) {
		LOG_WRN("Wait for thread terminate failed");
	}

	return 0;
}

static int do_tcp_client_connect(const char *url, uint16_t port)
{
	int ret;

	/* Open socket */
	if (proxy.sec_tag == INVALID_SEC_TAG) {
		ret = socket(proxy.family, SOCK_STREAM, IPPROTO_TCP);
		LOG_WRN("invalid security tag");
	} else {
		ret = socket(proxy.family, SOCK_STREAM, IPPROTO_TLS_1_2);
		LOG_WRN("valid security tag");
	}
	if (ret < 0) {
		LOG_ERR("socket() failed: %d", -errno);
		return ret;
	}
	proxy.sock = ret;

	if (proxy.sec_tag != INVALID_SEC_TAG) {
		LOG_ERR("settint TLS options");
		sec_tag_t sec_tag_list[1] = { proxy.sec_tag };
		int peer_verify = TLS_PEER_VERIFY_REQUIRED;

		ret = setsockopt(proxy.sock, SOL_TLS, TLS_SEC_TAG_LIST, sec_tag_list,
				 sizeof(sec_tag_t));
		if (ret) {
			LOG_ERR("setsockopt(TLS_SEC_TAG_LIST) error: %d", -errno);
			ret = -errno;
			goto exit_cli;
		}
		ret = setsockopt(proxy.sock, SOL_TLS, TLS_PEER_VERIFY, &peer_verify,
				 sizeof(peer_verify));
		if (ret) {
			LOG_ERR("setsockopt(TLS_PEER_VERIFY) error: %d", errno);
			ret = -errno;
			goto exit_cli;
		}

		ret = setsockopt(proxy.sock, SOL_TLS, TLS_HOSTNAME, url,
				 strlen(url) + 1);
		if (ret) {
			LOG_ERR("setsockopt(TLS_HOSTNAME) error: %d", -errno);
			ret = -errno;
			goto exit_cli;
		}
	}

	/* Connect to remote host */
	struct sockaddr sa = {
		.sa_family = AF_UNSPEC
	};

	ret = util_resolve_host(0, url, port, proxy.family, &sa);
	if (ret) {
		LOG_ERR("getaddrinfo() error: %s", log_strdup(gai_strerror(ret)));
		goto exit_cli;
	}
	if (sa.sa_family == AF_INET) {
		ret = connect(proxy.sock, &sa, sizeof(struct sockaddr_in));
	} else {
		ret = connect(proxy.sock, &sa, sizeof(struct sockaddr_in6));
	}
	if (ret) {
		LOG_ERR("connect() failed: %d", -errno);
		ret = -errno;
		goto exit_cli;
	}

	k_thread_create(&tcp_thread, tcp_thread_stack,
			K_THREAD_STACK_SIZEOF(tcp_thread_stack),
			tcpcli_thread_func, NULL, NULL, NULL,
			THREAD_PRIORITY, K_USER, K_NO_WAIT);

	proxy.role = TCP_ROLE_CLIENT;
	sprintf(rsp_buf, "\r\n#XTCPCLI: %d,\"connected\"\r\n", proxy.sock);
	rsp_send(rsp_buf, strlen(rsp_buf));

	return 0;

exit_cli:
	close(proxy.sock);
	proxy.sock = INVALID_SOCKET;
	sprintf(rsp_buf, "\r\n#XTCPCLI: %d,\"not connected\"\r\n", ret);
	rsp_send(rsp_buf, strlen(rsp_buf));

	return ret;
}

static int do_tcp_client_disconnect(void)
{
	int ret = 0;

	if (proxy.sock == INVALID_SOCKET) {
		return 0;
	}
	ret = close(proxy.sock);
	if (ret < 0) {
		LOG_WRN("close() failed: %d", -errno);
		ret = -errno;
	} else {
		proxy.sock = INVALID_SOCKET;
	}
	if (ret == 0 &&
	    k_thread_join(&tcp_thread, K_SECONDS(CONFIG_SLM_TCP_POLL_TIME * 2)) != 0) {
		LOG_WRN("Wait for thread terminate failed");
	}
	sprintf(rsp_buf, "\r\n#XTCPCLI: %d,\"disconnected\"\r\n", ret);
	rsp_send(rsp_buf, strlen(rsp_buf));

	return ret;
}

static int do_tcp_send(const uint8_t *data, int datalen)
{
	int ret = 0;
	uint32_t offset = 0;
	int sock = proxy.sock;

	if (proxy.role == TCP_ROLE_SERVER) {
		sock = proxy.sock_peer;
	}

	while (offset < datalen) {
		ret = send(sock, data + offset, datalen - offset, 0);
		if (ret < 0) {
			LOG_ERR("send() failed: %d, sent: %d", -errno, offset);
			ret = -errno;
			break;
		} else {
			offset += ret;
		}
	}

	if (ret >= 0) {
		sprintf(rsp_buf, "\r\n#XTCPSEND: %d\r\n", offset);
		rsp_send(rsp_buf, strlen(rsp_buf));
		return 0;
	}

	return ret;
}

static int do_tcp_send_datamode(const uint8_t *data, int datalen)
{
	int ret = 0;
	uint32_t offset = 0;
	int sock = proxy.sock;

	if (proxy.role == TCP_ROLE_SERVER) {
		sock = proxy.sock_peer;
	}

	while (offset < datalen) {
		ret = send(sock, data + offset, datalen - offset, 0);
		if (ret < 0) {
			LOG_ERR("send() failed: %d, sent: %d", -errno, offset);
			break;
		} else {
			offset += ret;
		}
	}

	return (offset > 0) ? offset : -1;
}

static int tcp_datamode_callback(uint8_t op, const uint8_t *data, int len)
{
	int ret = 0;

	if (op == DATAMODE_SEND) {
		ret = do_tcp_send_datamode(data, len);
		LOG_INF("datamode send: %d", ret);
	} else if (op == DATAMODE_EXIT) {
		LOG_DBG("datamode exit");
	}

	return ret;
}

/* Server-initiated disconnect */
static void tcpsvr_terminate_connection(int cause)
{
	if (in_datamode()) {
		(void)exit_datamode(DATAMODE_EXIT_URC);
	}
	if (proxy.sock_peer != INVALID_SOCKET) {
		close(proxy.sock_peer);
		proxy.sock_peer = INVALID_SOCKET;
		sprintf(rsp_buf, "\r\n#XTCPSVR: %d,\"disconnected\"\r\n", cause);
		rsp_send(rsp_buf, strlen(rsp_buf));
	}
}

/* TCP server thread */
static void tcpsvr_thread_func(void *p1, void *p2, void *p3)
{
	int ret;
	struct pollfd fds[2];

	ARG_UNUSED(p1);
	ARG_UNUSED(p2);
	ARG_UNUSED(p3);

	fds[0].fd = proxy.sock;
	fds[0].events = POLLIN;
	/** The field fd contains a file descriptor for an open file.  If this field is negative,
	 * then the corresponding events field is ignored and the revents field returns zero.
	 */
	fds[1].fd = INVALID_SOCKET;
	fds[1].events = POLLIN;
	while (true) {
		ret = poll(fds, 2, MSEC_PER_SEC * CONFIG_SLM_TCP_POLL_TIME);
		if (server_stop_pending) {  /* server wait to stop */
			ret = 0;
			break;
		}
		if (ret < 0) { /* IO error */
			LOG_WRN("poll() error: %d", -errno);
			ret = -EIO;
			break;
		}
		if (ret == 0) { /* timeout */
			continue;
		}
		LOG_DBG("fds[0] events 0x%08x", fds[0].revents);
		LOG_DBG("fds[1] events 0x%08x", fds[1].revents);
		/* Listening socket events must be handled first*/
		if (fds[0].revents) {
			if ((fds[0].revents & POLLERR) == POLLERR) {
				LOG_ERR("0: POLLERR");
				ret = -EIO;
				break;
			}
			if ((fds[0].revents & POLLHUP) == POLLHUP) {
				LOG_WRN("0: POLLHUP");
				ret = -ECONNRESET;
				break;
			}
			if ((fds[0].revents & POLLNVAL) == POLLNVAL) {
				/* server stopped by AT command */
				LOG_WRN("0: POLLNVAL");
				ret = -ENETDOWN;
				break;
			}
			if ((fds[0].revents & POLLIN) != POLLIN) {
				/* Ignore and check whether there are client events */
				goto client_events;
			}

			/* Accept incoming connection */
			char peer_addr[INET6_ADDRSTRLEN] = {0};
			socklen_t len;

			if (proxy.family == AF_INET) {
				struct sockaddr_in client;

				len = sizeof(struct sockaddr_in);
				ret = accept(proxy.sock, (struct sockaddr *)&client, &len);
				if (ret == -1) {
					LOG_WRN("accept(ipv4) error: %d", -errno);
					goto client_events;
				}
				(void)inet_ntop(AF_INET, &client.sin_addr, peer_addr,
					sizeof(peer_addr));
			} else {
				struct sockaddr_in6 client;

				len = sizeof(struct sockaddr_in6);
				ret = accept(proxy.sock, (struct sockaddr *)&client, &len);
				if (ret == -1) {
					LOG_WRN("accept(ipv6) error: %d", -errno);
					goto client_events;
				}
				(void)inet_ntop(AF_INET6, &client.sin6_addr, peer_addr,
					sizeof(peer_addr));
			}
			if (fds[1].fd >= 0) {
				LOG_WRN("Full. Close connection.");
				close(ret);
				goto client_events;
			}
			proxy.sock_peer = ret;
			fds[1].fd = proxy.sock_peer;
			sprintf(rsp_buf, "\r\n#XTCPSVR: \"%s\",\"connected\"\r\n", peer_addr);
			rsp_send(rsp_buf, strlen(rsp_buf));
			LOG_DBG("New connection - %d", proxy.sock_peer);
		}
client_events:
		/* Incoming socket events */
		if (fds[1].revents) {
			if ((fds[1].revents & POLLERR) == POLLERR) {
				LOG_ERR("1: POLLERR");
				tcpsvr_terminate_connection(-EIO);
				fds[1].fd = INVALID_SOCKET;
				continue;
			}
			if ((fds[1].revents & POLLHUP) == POLLHUP) {
				LOG_ERR("1: POLLHUP");
				tcpsvr_terminate_connection(-ECONNRESET);
				fds[1].fd = INVALID_SOCKET;
				continue;
			}
			if ((fds[1].revents & POLLNVAL) == POLLNVAL) {
				LOG_WRN("1: POLLNVAL");
				tcpsvr_terminate_connection(-ENETDOWN);
				fds[1].fd = INVALID_SOCKET;
				continue;
			}
			if ((fds[1].revents & POLLIN) != POLLIN) {
				continue;
			}
			/* Receive data */
			char rx_data[SLM_MAX_PAYLOAD];

			ret = recv(fds[1].fd, (void *)rx_data, sizeof(rx_data), 0);
			if (ret < 0) {
				LOG_WRN("recv() error: %d", -errno);
				continue;
			}
			if (ret == 0) {
				continue;
			}
			if (in_datamode()) {
				data_send(rx_data, ret);
			} else {
				rsp_send(rx_data, ret);
				sprintf(rsp_buf, "\r\n#XTCPDATA: %d\r\n", ret);
				rsp_send(rsp_buf, strlen(rsp_buf));
			}
		}
	}

#if defined(CONFIG_SLM_NATIVE_TLS)
	if (proxy.sec_tag != INVALID_SEC_TAG) {
		(void)slm_tls_unloadcrdl(proxy.sec_tag);
		proxy.sec_tag = INVALID_SEC_TAG;
	}
#endif
	tcpsvr_terminate_connection(ret);
	if (proxy.sock != INVALID_SOCKET) {
		(void)close(proxy.sock);
		proxy.sock = INVALID_SOCKET;
	}
	sprintf(rsp_buf, "\r\n#XTCPSVR: %d,\"stopped\"\r\n", ret);
	rsp_send(rsp_buf, strlen(rsp_buf));
	server_stop_pending = false;
	LOG_INF("TCP server thread terminated");
}

/* TCP client thread */
static void tcpcli_thread_func(void *p1, void *p2, void *p3)
{
	int ret;
	static struct pollfd fds;

	ARG_UNUSED(p1);
	ARG_UNUSED(p2);
	ARG_UNUSED(p3);

	fds.fd = proxy.sock;
	fds.events = POLLIN;
	while (true) {
		ret = poll(&fds, 1, MSEC_PER_SEC * CONFIG_SLM_TCP_POLL_TIME);
		if (ret < 0) {  /* IO error */
			LOG_WRN("poll() error: %d", ret);
			ret = -EIO;
			break;
		}
		if (ret == 0) {  /* timeout */
			continue;
		}
		LOG_DBG("Poll events 0x%08x", fds.revents);
		if ((fds.revents & POLLERR) == POLLERR) {
			LOG_ERR("POLLERR");
			ret = -EIO;
			break;
		}
		if ((fds.revents & POLLNVAL) == POLLNVAL) {
			/* client disconnected locally by AT command */
			LOG_WRN("POLLNVAL");
			ret = -ENETDOWN;
			break;
		}
		if ((fds.revents & POLLHUP) == POLLHUP) {
			/* client disconnected by remote or lose LTE connection */
			LOG_WRN("POLLHUP");
			ret = -ECONNRESET;
			break;
		}
		if ((fds.revents & POLLIN) != POLLIN) {
			continue;
		}
		/* Receive data */
		char rx_data[SLM_MAX_PAYLOAD];

		ret = recv(fds.fd, (void *)rx_data, sizeof(rx_data), 0);
		if (ret < 0) {
			LOG_WRN("recv() error: %d", -errno);
			continue;
		}
		if (ret == 0) {
			continue;
		}
		if (in_datamode()) {
			data_send(rx_data, ret);
		} else {
			rsp_send(rx_data, ret);
			sprintf(rsp_buf, "\r\n#XTCPDATA: %d\r\n", ret);
			rsp_send(rsp_buf, strlen(rsp_buf));
		}
	}

	if (in_datamode()) {
		(void)exit_datamode(DATAMODE_EXIT_URC);
	}
	if (proxy.sock != INVALID_SOCKET) {
		(void)close(proxy.sock);
		proxy.sock = INVALID_SOCKET;
		sprintf(rsp_buf, "\r\n#XTCPCLI: %d,\"disconnected\"\r\n", ret);
		rsp_send(rsp_buf, strlen(rsp_buf));
	}

	LOG_INF("TCP client thread terminated");
}

/**@brief handle AT#XTCPSVR commands
 *  AT#XTCPSVR=<op>[,<port>[,[sec_tag]]
 *  AT#XTCPSVR?
 *  AT#XTCPSVR=?
 */
int handle_at_tcp_server(enum at_cmd_type cmd_type)
{
	int err = -EINVAL;
	uint16_t op;
	uint16_t port;
	int param_count = at_params_valid_count_get(&at_param_list);

	switch (cmd_type) {
	case AT_CMD_TYPE_SET_COMMAND:
		err = at_params_unsigned_short_get(&at_param_list, 1, &op);
		if (err) {
			return err;
		}
		if (op == SERVER_START || op == SERVER_START6) {
			if (proxy.sock != INVALID_SOCKET) {
				LOG_ERR("Server is running.");
				return -EINVAL;
			}
			err = at_params_unsigned_short_get(&at_param_list, 2, &port);
			if (err) {
				return err;
			}
			proxy.sec_tag = INVALID_SEC_TAG;
			if (param_count > 3) {
				err = at_params_int_get(&at_param_list, 3, &proxy.sec_tag);
				if (err) {
					return err;
				}
			}
			proxy.family = (op == SERVER_START) ? AF_INET : AF_INET6;
			err = do_tcp_server_start(port);
		} else if (op == SERVER_STOP) {
			err = do_tcp_server_stop();
		} break;

	case AT_CMD_TYPE_READ_COMMAND:
		sprintf(rsp_buf, "\r\n#XTCPSVR: %d,%d,%d\r\n",
			proxy.sock, proxy.sock_peer, proxy.family);
		rsp_send(rsp_buf, strlen(rsp_buf));
		err = 0;
		break;

	case AT_CMD_TYPE_TEST_COMMAND:
		sprintf(rsp_buf, "\r\n#XTCPSVR: (%d,%d,%d),<port>,<sec_tag>\r\n",
			SERVER_STOP, SERVER_START, SERVER_START6);
		rsp_send(rsp_buf, strlen(rsp_buf));
		err = 0;
		break;

	default:
		break;
	}

	return err;
}

/**@brief handle AT#XTCPCLI commands
 *  AT#XTCPCLI=<op>[,<url>,<port>[,[sec_tag]]
 *  AT#XTCPCLI?
 *  AT#XTCPCLI=?
 */
int handle_at_tcp_client(enum at_cmd_type cmd_type)
{
	int err = -EINVAL;
	uint16_t op;
	int param_count = at_params_valid_count_get(&at_param_list);

	switch (cmd_type) {
	case AT_CMD_TYPE_SET_COMMAND:
		err = at_params_unsigned_short_get(&at_param_list, 1, &op);
		if (err) {
			return err;
		}
		if (op == CLIENT_CONNECT || op == CLIENT_CONNECT6) {
			uint16_t port;
			char url[SLM_MAX_URL];
			int size = SLM_MAX_URL;

			if (proxy.sock != INVALID_SOCKET) {
				LOG_ERR("Client is connected.");
				return -EINVAL;
			}
			err = util_string_get(&at_param_list, 2, url, &size);
			if (err) {
				return err;
			}
			err = at_params_unsigned_short_get(&at_param_list, 3, &port);
			if (err) {
				return err;
			}
			proxy.sec_tag = INVALID_SEC_TAG;
			if (param_count > 4) {
				err = at_params_int_get(&at_param_list, 4, &proxy.sec_tag);
				if (err) {
					return err;
				}
			}
			proxy.family = (op == CLIENT_CONNECT) ? AF_INET : AF_INET6;
			err = do_tcp_client_connect(url, port);
		} else if (op == CLIENT_DISCONNECT) {
			err = do_tcp_client_disconnect();
		} break;

	case AT_CMD_TYPE_READ_COMMAND:
		sprintf(rsp_buf, "\r\n#XTCPCLI: %d,%d\r\n", proxy.sock, proxy.family);
		rsp_send(rsp_buf, strlen(rsp_buf));
		err = 0;
		break;

	case AT_CMD_TYPE_TEST_COMMAND:
		sprintf(rsp_buf, "\r\n#XTCPCLI: (%d,%d,%d),<url>,<port>,<sec_tag>\r\n",
			CLIENT_DISCONNECT, CLIENT_CONNECT, CLIENT_CONNECT6);
		rsp_send(rsp_buf, strlen(rsp_buf));
		err = 0;
		break;

	default:
		break;
	}

	return err;
}

/**@brief handle AT#XTCPSEND commands
 *  AT#XTCPSEND[=<data>]
 *  AT#XTCPSEND? READ command not supported
 *  AT#XTCPSEND=? TEST command not supported
 */
int handle_at_tcp_send(enum at_cmd_type cmd_type)
{
	int err = -EINVAL;
	char data[SLM_MAX_PAYLOAD + 1] = {0};
	int size;

	switch (cmd_type) {
	case AT_CMD_TYPE_SET_COMMAND:
		if (at_params_valid_count_get(&at_param_list) > 1) {
			size = sizeof(data);
			err = util_string_get(&at_param_list, 1, data, &size);
			if (err) {
				return err;
			}
			err = do_tcp_send(data, size);
		} else {
			err = enter_datamode(tcp_datamode_callback);
		}
		break;

	default:
		break;
	}

	return err;
}

/**@brief handle AT#XTCPHANGUP commands
 *  AT#XTCPHANGUP=<handle>
 *  AT#XTCPHANGUP? READ command not supported
 *  AT#XTCPHANGUP=?
 */
int handle_at_tcp_hangup(enum at_cmd_type cmd_type)
{
	int err = -EINVAL;
	int handle;

	switch (cmd_type) {
	case AT_CMD_TYPE_SET_COMMAND:
		if (proxy.role != TCP_ROLE_SERVER || proxy.sock_peer == INVALID_SOCKET) {
			return -EINVAL;
		}
		err = at_params_int_get(&at_param_list, 1, &handle);
		if (err) {
			return err;
		}
		if (handle != proxy.sock_peer) {
			return -EINVAL;
		}
		tcpsvr_terminate_connection(-ECONNREFUSED);
		err = 0;
		break;

	case AT_CMD_TYPE_TEST_COMMAND:
		sprintf(rsp_buf, "\r\n#XTCPHANGUP: <handle>\r\n");
		rsp_send(rsp_buf, strlen(rsp_buf));
		err = 0;
		break;

	default:
		break;
	}

	return err;
}

/**@brief API to initialize TCP proxy AT commands handler
 */
int slm_at_tcp_proxy_init(void)
{
	proxy.sock      = INVALID_SOCKET;
	proxy.family    = AF_UNSPEC;
	proxy.sock_peer = INVALID_SOCKET;
	proxy.role      = INVALID_ROLE;
	proxy.sec_tag   = INVALID_SEC_TAG;

	return 0;
}

/**@brief API to uninitialize TCP proxy AT commands handler
 */
int slm_at_tcp_proxy_uninit(void)
{
	if (proxy.role == TCP_ROLE_CLIENT) {
		return do_tcp_client_disconnect();
	}
	if (proxy.role == TCP_ROLE_SERVER) {
		return do_tcp_server_stop();
	}

	return 0;
}
```
